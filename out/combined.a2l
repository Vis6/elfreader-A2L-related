/begin PROJECT NONAME ""
/begin MODULE NONAME ""
/begin MEASUREMENT duty_cycle "Current SNA." UBYTE VOID_SCALING_CRFR_a 1 100 0 1 ECU_ADDRESS 0x201130 BYTE_ORDER MSB_LAST /end MEASUREMENT
/begin MEASUREMENT dividend "Current controller bandwidth." FLOAT32_IEEE Hertz_sc 1 100 -3.4028234663852886e38 3.4028234663852886e38 ECU_ADDRESS 0x201134 BYTE_ORDER MSB_LAST /end MEASUREMENT
/begin MEASUREMENT xemacpsif_input "Direct axis stator current, filtered." FLOAT32_IEEE Ampere_sc 1 100 -3.4028234663852886e38 3.4028234663852886e38 ECU_ADDRESS 0x10f15c BYTE_ORDER MSB_LAST /end MEASUREMENT
/begin MEASUREMENT XEmacPs_StubHandler "Quadrature axis stator current, filtered." FLOAT32_IEEE VOID_SCALING_CRFR 1 100 -3.4028234663852886e38 3.4028234663852886e38 ECU_ADDRESS 0x116018 BYTE_ORDER MSB_LAST /end MEASUREMENT
/begin MEASUREMENT sys_arch_protect "" FLOAT32_IEEE VOID_SCALING_CRFR 1 100 -3.4028234663852886e38 3.4028234663852886e38 ECU_ADDRESS 0x109cb4 BYTE_ORDER MSB_LAST /end MEASUREMENT
/begin MEASUREMENT transfer_data "" FLOAT32_IEEE VOID_SCALING_CRFR 1 100 -3.4028234663852886e38 3.4028234663852886e38 ECU_ADDRESS 0x1007ac BYTE_ORDER MSB_LAST /end MEASUREMENT
/begin CHARACTERISTIC eth_link_status "Switch to enable(1) or disable(0) the override of the currentcontroller IGain factor for calibration of non-ED units" VALUE 0x2001cc UBYTE_COL_DIRECT 0 VOID_SCALING_CRFR_a 0 1 BYTE_ORDER MSB_LAST /end CHARACTERISTIC
/begin CHARACTERISTIC memp_memory_TCP_SEG_base "Switch to enable(1) or disable(0) the override of the currentcontroller target bandwidth for calibration of non-ED units" VALUE 0x221a78 UBYTE_COL_DIRECT 0 VOID_SCALING_CRFR_a 0 1 BYTE_ORDER MSB_LAST /end CHARACTERISTIC
/begin CHARACTERISTIC Xil_ICacheInvalidate "Switch to enable(1) or disable(0) the override of the currentcontroller gain for calibration of non-ED units" VALUE 0x1068f0 UBYTE_COL_DIRECT 0 VOID_SCALING_CRFR_a 0 1 BYTE_ORDER MSB_LAST /end CHARACTERISTIC
/begin CHARACTERISTIC pbuf_copy_partial "Current achieved signal SNA override enable." VALUE 0x1098a8 UBYTE_COL_DIRECT 0 VOID_SCALING_CRFR_a 0 1 BYTE_ORDER MSB_LAST /end CHARACTERISTIC
/begin CHARACTERISTIC udp_disconnect "Current achieved signal SNA override value." VALUE 0x10ec90 UBYTE_COL_DIRECT 0 VOID_SCALING_CRFR_a 0 1 BYTE_ORDER MSB_LAST /end CHARACTERISTIC
/begin CHARACTERISTIC memp_TCP_PCB "single value used to override the currentcontroller target bandwidth for calibration of non-ED units" VALUE 0x1188b0 FLOAT32_IEEE_COL_DIRECT 0 Hertz_sc -3.4028234663852886e38 3.4028234663852886e38 BYTE_ORDER MSB_LAST /end CHARACTERISTIC
/end MODULE
/end PROJECT
