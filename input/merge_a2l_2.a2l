/begin MEASUREMENT const_signal "" FLOAT32_IEEE ulData000.CONVERSION 0 0 0 100 BYTE_ORDER MSB_LAST ECU_ADDRESS 0x201B3A8 FORMAT "%.3" /end MEASUREMENT
/begin MEASUREMENT duty_cycle "" ULONG DUTY_CYCLE_CONVERSION2 0 0 0 2 BYTE_ORDER MSB_LAST ECU_ADDRESS 0x201B3AC FORMAT "%.3" /end MEASUREMENT
/begin MEASUREMENT divisor_debug "" ULONG ulData000.CONVERSION 0 0 0 100000 BYTE_ORDER MSB_LAST ECU_ADDRESS 0x201B3B0 FORMAT "%.0" /end MEASUREMENT
/begin MEASUREMENT dividend_debug "" ULONG ulData000.CONVERSION 0 0 0 100000 BYTE_ORDER MSB_LAST ECU_ADDRESS 0x201B3B4 FORMAT "%.0" /end MEASUREMENT
