/begin CHARACTERISTIC enable_signal_input "" VALUE 0x1C0034 __UBYTE 100 ulData000.CONVERSION 0 1 BYTE_ORDER MSB_LAST FORMAT "%.0" /end CHARACTERISTIC
/begin CHARACTERISTIC threshold_input "" VALUE 0x1BE234 __UBYTE 100 ulData000.CONVERSION 0 99 BYTE_ORDER MSB_LAST FORMAT "%.3" /end CHARACTERISTIC
/begin MEASUREMENT threshold "" UBYTE ulData000.CONVERSION 0 0 0 100 READ_WRITE BYTE_ORDER MSB_LAST ECU_ADDRESS 0x201B3A0 FORMAT "%.3" /end MEASUREMENT
/begin MEASUREMENT enable_signal "" UBYTE ulData000.CONVERSION 0 0 0 2 READ_WRITE BYTE_ORDER MSB_LAST ECU_ADDRESS 0x201B3A4 FORMAT "%.0" /end MEASUREMENT
