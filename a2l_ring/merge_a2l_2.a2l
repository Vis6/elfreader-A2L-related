/begin CHARACTERISTIC pbuf_copy_partial "Current achieved signal SNA override enable." VALUE 0x0000 UBYTE_COL_DIRECT 0 VOID_SCALING_CRFR_a 0 1 BYTE_ORDER MSB_LAST /end CHARACTERISTIC
/begin CHARACTERISTIC udp_disconnect "Current achieved signal SNA override value." VALUE 0x0000 UBYTE_COL_DIRECT 0 VOID_SCALING_CRFR_a 0 1 BYTE_ORDER MSB_LAST /end CHARACTERISTIC
/begin CHARACTERISTIC memp_TCP_PCB "single value used to override the currentcontroller target bandwidth for calibration of non-ED units" VALUE 0x0000 FLOAT32_IEEE_COL_DIRECT 0 Hertz_sc -3.4028234663852886e38 3.4028234663852886e38 BYTE_ORDER MSB_LAST /end CHARACTERISTIC
/begin MEASUREMENT XEmacPs_StubHandler "Quadrature axis stator current, filtered." FLOAT32_IEEE VOID_SCALING_CRFR 1 100 -3.4028234663852886e38 3.4028234663852886e38 ECU_ADDRESS 0x0000 BYTE_ORDER MSB_LAST /end MEASUREMENT
/begin MEASUREMENT sys_arch_protect "" FLOAT32_IEEE VOID_SCALING_CRFR 1 100 -3.4028234663852886e38 3.4028234663852886e38 ECU_ADDRESS 0x0000 BYTE_ORDER MSB_LAST /end MEASUREMENT
/begin MEASUREMENT transfer_data "" FLOAT32_IEEE VOID_SCALING_CRFR 1 100 -3.4028234663852886e38 3.4028234663852886e38 ECU_ADDRESS 0x0000 BYTE_ORDER MSB_LAST /end MEASUREMENT
