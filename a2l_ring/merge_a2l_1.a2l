/begin CHARACTERISTIC eth_link_status "Switch to enable(1) or disable(0) the override of the currentcontroller IGain factor for calibration of non-ED units" VALUE 0x0000 UBYTE_COL_DIRECT 0 VOID_SCALING_CRFR_a 0 1 BYTE_ORDER MSB_LAST /end CHARACTERISTIC
/begin CHARACTERISTIC memp_memory_TCP_SEG_base "Switch to enable(1) or disable(0) the override of the currentcontroller target bandwidth for calibration of non-ED units" VALUE 0x0000 UBYTE_COL_DIRECT 0 VOID_SCALING_CRFR_a 0 1 BYTE_ORDER MSB_LAST /end CHARACTERISTIC
/begin CHARACTERISTIC Xil_ICacheInvalidate "Switch to enable(1) or disable(0) the override of the currentcontroller gain for calibration of non-ED units" VALUE 0x0000 UBYTE_COL_DIRECT 0 VOID_SCALING_CRFR_a 0 1 BYTE_ORDER MSB_LAST /end CHARACTERISTIC
/begin MEASUREMENT duty_cycle "Current SNA." UBYTE VOID_SCALING_CRFR_a 1 100 0 1 ECU_ADDRESS 0x0000 BYTE_ORDER MSB_LAST /end MEASUREMENT
/begin MEASUREMENT dividend "Current controller bandwidth." FLOAT32_IEEE Hertz_sc 1 100 -3.4028234663852886e38 3.4028234663852886e38 ECU_ADDRESS 0x0000 BYTE_ORDER MSB_LAST /end MEASUREMENT
/begin MEASUREMENT xemacpsif_input "Direct axis stator current, filtered." FLOAT32_IEEE Ampere_sc 1 100 -3.4028234663852886e38 3.4028234663852886e38 ECU_ADDRESS 0x0000 BYTE_ORDER MSB_LAST /end MEASUREMENT
